## boards/arm/ergokeeb_corne/Kconfig.board
```kconfig
#
# Copyright (c) 2024 The ZMK Contributors
# SPDX-License-Identifier: MIT
#

config BOARD_ERGOKEEB_CORNE_LEFT
    bool "ergokeeb_corne left"
    depends on SOC_NRF52840_QIAA

config BOARD_ERGOKEEB_CORNE_RIGHT
    bool "ergokeeb_corne right"
    depends on SOC_NRF52840_QIAA
```

## boards/arm/prospector_corne/Kconfig.board
```kconfig
#
# Copyright (c) 2024 The ZMK Contributors
# SPDX-License-Identifier: MIT
#

config BOARD_PROSPECTOR_CORNE_LEFT
    bool "prospector_corne left"
    depends on SOC_NRF52840_QIAA

config BOARD_PROSPECTOR_CORNE_RIGHT
    bool "prospector_corne right"
    depends on SOC_NRF52840_QIAA
```

## boards/arm/zmk_dongle/Kconfig.board
```kconfig
# Copyright (c) 2024 The ZMK Contributors
# SPDX-License-Identifier: MIT

config BOARD_ZMK_DONGLE
    bool "ZMK Dongle"
    depends on SOC_NRF52840_QIAA
```

## boards/arm/zmk_dongle/Kconfig.defconfig
```kconfig
# Copyright (c) 2024 The ZMK Contributors
# SPDX-License-Identifier: MIT

if BOARD_ZMK_DONGLE

config BOARD
    default "zmk_dongle"

config ZMK_KEYBOARD_NAME
    default "ZMK Dongle"

if USB_DEVICE_STACK

config USB_NRFX
    default y

endif # USB_DEVICE_STACK

config BT_CTLR
    default BT

config ZMK_BLE
    default y

config ZMK_USB
    default y


endif # BOARD_ZMK_DONGLE
```

## config/west.yml
```yaml
manifest:
  remotes:
    - name: zmkfirmware
      url-base: https://github.com/zmkfirmware
    # Additional modules containing boards/shields/custom code can be listed here as well
    # See https://docs.zephyrproject.org/3.2.0/develop/west/manifest.html#projects
    - name: m165437
      url-base: https://github.com/M165437
    - name: carrefinho
      url-base: https://github.com/carrefinho
    - name: pandakb
      url-base: https://github.com/PandaKBLab
    - name: urob
      url-base: https://github.com/urob
  projects:
    - name: zmk
      remote: zmkfirmware
      revision: main
      import: app/west.yml
    - name: nice-view-gem
      remote: m165437
      revision: main
    - name: prospector-zmk-module
      remote: carrefinho
      revision: main
    - name: corne-j-keyboard-zmk
      remote: pandakb
      revision: main
#      import: config/west.yml
#    - name: zmk-leader-key
#      remote: urob
#      #revision: v0.2 # set to same as urob's patched ZMK version, and build against that if there are build errors as per urob' doc
  self:
    path: config
```
